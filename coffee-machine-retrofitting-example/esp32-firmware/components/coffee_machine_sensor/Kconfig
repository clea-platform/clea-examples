## coffee-machine-retrofitting-example/esp32-firmware/components/coffee_machine_sensor/Kconfig
```kconfig
menu "Coffee machine sensor"

config COFFEE_MACHINE_SENSOR
    int "Coffee machine sensor type"
    default 0
    help
        The sensor used to obtain information from machine. Possible values are: 
            0: emulated
            1: delonghi
endmenu
```

## eva-dts-table-top/easy-edge-firmware/components/astarte_handler/Kconfig
```kconfig
menu "Astarte handler"

    config USE_FIXED_ID
        bool "Use fixed ID"
        default false
        help
            Use fixed Astarte ID (contained in 'CONFIG_ASTARTE_ID') instead of hardware generated ID.

    config ASTARTE_ID
        string "Astarte fixed device ID"
        default "G9q14mi9XFiQbj4hb8HYzg"
        depends on USE_FIXED_ID
        help
            Astarte identifier to be used if 'CONFIG_USE_FIXED_ID' is true.
endmenu
```

## eva-dts-table-top/easy-edge-firmware/components/eva_dts_engine/Kconfig
```kconfig
menu "EVA-DTS Sensor ID Configuration"
    config EVADTS_MACHINE_ID
        string "evadts machine_id"
        default "machine_id"

    config  USE_RECORDED_DATA
        bool "Use aleady recoded data saved in flash memory"
        default n

    config PUBLISH_DELAY_SECONDS
        int "Delay between two publish request to Astarte"
        default 60

    config EVADTS_SENSOR_ESPRESSO
        string "evadts espresso sensor"
        default "39"

    config EVADTS_SENSOR_COFFEE
        string "evadts coffee sensor"
        default "40"

    config EVADTS_SENSOR_AMERICANO
        string "evadts americano sensor"
        default "41"
endmenu
```

## eva-dts-table-top/easy-edge-firmware/components/udp_remote_debugger/Kconfig
```kconfig
menu "UDP remote debugger configuration"
    config DEVICE_ID
        string "Device identifier prefixed to debug string"
        default "eva dts engine"

    config SERVER_IP
        string "IP of target machine running UDP server"
        default "192.168.1.1"

    config SERVER_PORT
        int "Port number of target machine running UDP server"
        default 9090

endmenu
```

## eva-dts-table-top/easy-edge-firmware/main/Kconfig
```kconfig
menu "Tabletop Coffee Machine demo"

    config WIFI_SSID
        string "WiFi SSID"
        default "myssid"
        help
            SSID (network name) for the example to connect to.
    
    config WIFI_PASSWORD
        string "WiFi Password"
        default "mypassword"
        help
            WiFi password (WPA or WPA2) for the example to use.
    
    config WIFI_MAXIMUM_RETRY
        int "WiFi maximum retry"
        default 10
        help
            Maximum number of retrials to connect to wifi AP.

    config EVA_DTS_MAXIMUM_RETRY
        int "EVA DTS communication retrials"
        default 10
        help
            Maximum retrials number in case if EVA DTS comunication initialization error
    endmenu
    
```

## ventilation-predictive-maintenance/easy-edge-firmware/main/Kconfig
```kconfig
menu "Ventilation Motor Predictive Maintenance"

    config WIFI_SSID
        string "WiFi SSID"
        default "myssid"
        help
            SSID (network name) for the example to connect to.
    
    config WIFI_PASSWORD
        string "WiFi Password"
        default "mypassword"
        help
            WiFi password (WPA or WPA2) for the example to use.
    
    config WIFI_MAXIMUM_RETRY
        int "WiFi maximum retry"
        default 10
        help
            Maximum number of retrials to connect to wifi AP.
endmenu
```
